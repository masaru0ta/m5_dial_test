## m5dial-tetris/sdkconfig.defaults
```kconfig
# M5Dial (ESP32-S3) Configuration

# Target
CONFIG_IDF_TARGET="esp32s3"

# ESP32S3-Specific
CONFIG_ESP32S3_DEFAULT_CPU_FREQ_240=y
CONFIG_ESP32S3_DATA_CACHE_64KB=y
CONFIG_ESP32S3_INSTRUCTION_CACHE_32KB=y

# Flash Configuration
CONFIG_ESPTOOLPY_FLASHSIZE_8MB=y
CONFIG_ESPTOOLPY_FLASHMODE_DIO=y
CONFIG_ESPTOOLPY_FLASHFREQ_80M=y

# Partition Table (OTA enabled)
CONFIG_PARTITION_TABLE_CUSTOM=y
CONFIG_PARTITION_TABLE_CUSTOM_FILENAME="partitions_ota.csv"

# FreeRTOS
CONFIG_FREERTOS_HZ=1000

# Serial flasher config
CONFIG_ESPTOOLPY_BAUD_921600B=y

# USB-Serial JTAG Configuration (for M5Dial USB-C)
CONFIG_ESP_CONSOLE_USB_SERIAL_JTAG=y

# Component config
CONFIG_ESP_DEFAULT_CPU_FREQ_MHZ_240=y

# Enable C++ exceptions
CONFIG_COMPILER_CXX_EXCEPTIONS=y

# Increase main task stack size
CONFIG_ESP_MAIN_TASK_STACK_SIZE=8192

# Enable GPIO ISR service
CONFIG_GPIO_ESP32_SUPPORT_SWITCH_SLP_PULL=y
```
